## sdkconfig.defaults
```kconfig
CONFIG_IDF_TARGET="esp32"

# NimBLE (preferred over Bluedroid for this project)
CONFIG_BT_ENABLED=y
CONFIG_BT_NIMBLE_ENABLED=y
CONFIG_BT_BLUEDROID_ENABLED=

# Larger main task stack — radiosonde decoder needs headroom
CONFIG_ESP_MAIN_TASK_STACK_SIZE=8192

# HTTP server
CONFIG_HTTPD_MAX_REQ_HDR_LEN=1024
CONFIG_HTTPD_MAX_URI_LEN=512

# Watchdog (60 s task watchdog per FSD §4 FR-13)
CONFIG_ESP_TASK_WDT_INIT=y
CONFIG_ESP_TASK_WDT_TIMEOUT_S=60
CONFIG_ESP_TASK_WDT_PANIC=y

# Logging
CONFIG_LOG_DEFAULT_LEVEL_INFO=y

# Partition table — custom layout giving each OTA slot 1.5MB
CONFIG_PARTITION_TABLE_CUSTOM=y
CONFIG_PARTITION_TABLE_CUSTOM_FILENAME="partitions.csv"
CONFIG_PARTITION_TABLE_FILENAME="partitions.csv"

# Flash size — SLOT3 board has 4MB flash
CONFIG_ESPTOOLPY_FLASHSIZE_4MB=y

# OTA over HTTPS
CONFIG_ESP_HTTPS_OTA_ALLOW_HTTP=n

# IRAM relief — move non-critical code paths to flash so BLE+WiFi+httpd fit.
CONFIG_ESP_WIFI_IRAM_OPT=n
CONFIG_ESP_WIFI_RX_IRAM_OPT=n
CONFIG_FREERTOS_PLACE_FUNCTIONS_INTO_FLASH=y
CONFIG_FREERTOS_PLACE_SNAPSHOT_FUNS_INTO_FLASH=y
CONFIG_RINGBUF_PLACE_FUNCTIONS_INTO_FLASH=y
CONFIG_RINGBUF_PLACE_ISR_FUNCTIONS_INTO_FLASH=y
CONFIG_HEAP_PLACE_FUNCTION_INTO_FLASH=y
CONFIG_SPI_FLASH_ROM_IMPL=y
```
